## pmsis/test_periph/gap_builder/src/gap_flasher/Config.in
```kconfig
config AOS_APP_GAP_FLASHER
    bool "gap_flasher"
    select AOS_COMP_OSAL_AOS
    help
        gap_flasher (to be used with openocd)

if AOS_APP_GAP_FLASHER
# Configurations for app gap_flasher
endif
```

## pmsis/test_periph/gap_builder/src/gap_fuser/Config.in
```kconfig
config AOS_APP_GAP_FUSER
    bool "gap_fuser"
    select AOS_COMP_OSAL_AOS
    help
        gap_fuser (to be used with openocd)

if AOS_APP_GAP_FUSER
# Configurations for app gap_fuser
endif
```
